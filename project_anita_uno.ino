#include <SoftwareSerial.h>
#include <Adafruit_NeoPixel.h>

SoftwareSerial mySerial(2,3); //RX TX

void ringLightDriver(int opCode, int R, int G, int B);
void motorDriver(int incomingOpCode);

int movementFlag = 0;

//motor 1 pins
int motor1pin1 = 9;
int motor1pin2 = 8;

//motor 2 pins
int motor2pin1 = 7;
int motor2pin2 = 6;

//ringLights
int pixelring = 5; 
int numofLEDS = 16;
int delayval = 4000;

Adafruit_NeoPixel pixels = Adafruit_NeoPixel(numofLEDS, pixelring, NEO_GRB+NEO_KHZ800);

void ringLightDriver(int opCode, int R, int G, int B){
  //0 for boot up
  //1 for serial connection sucessful, awaiting for command
  //2 for movement
  
  uint8_t i;
  uint8_t offset = 0;

  if(opCode == 0){
    for(i=0; i<numofLEDS; i++){
     pixels.setPixelColor(i, pixels.Color(R,G,B));
     pixels.show();
     delay(50);
   } 
   delay(50);
  }

  if(opCode == 1){
    for(i = 0; i<numofLEDS; i++){
      pixels.setPixelColor(i, pixels.Color(R,G,B));
    }
    pixels.show();
    delay(delayval);
  }
  if(opCode ==2){
      for(i=0; i<numofLEDS; i++){
        pixels.setPixelColor(i, pixels.Color(R,G,B));
        pixels.show();
        delay(50); 
        } 

    
  }
}

void setup() {
  // put your setup code here, to run once:
  Serial.begin(115200); //prints values generated by the arduino board
  mySerial.begin(115200); //prints values transmitted from the ESP 32 board

  //ringLights initialization
  pixels.begin(); 
  pixels.setBrightness(2); //x/255
  
  pinMode(motor1pin1, OUTPUT);
  pinMode(motor1pin2, OUTPUT);
  pinMode(motor2pin1, OUTPUT);
  pinMode(motor2pin2, OUTPUT);

   ringLightDriver(0, 255, 0, 0);

  Serial.println("Setup Done!");
}

void loop() {
  // put your main code here, to run repeatedly:
 
  int stringlen;
  int IncomingCode;
      
 

  if(mySerial.available()>0){
    
      ringLightDriver(1, 0, 0, 255);
      
      IncomingCode = mySerial.read();

      Serial.println(IncomingCode);
   
      if(IncomingCode == 1){ 
  
      
        digitalWrite(motor1pin1, HIGH);
        digitalWrite(motor1pin2, LOW);
    
        digitalWrite(motor2pin1, HIGH);
        digitalWrite(motor2pin2, LOW);

        
      }
      if(IncomingCode == 2){

          digitalWrite(motor1pin1, LOW);
          digitalWrite(motor1pin2, HIGH);
    
          digitalWrite(motor2pin1, LOW );
          digitalWrite(motor2pin2, HIGH);
    
      }
        
      if(IncomingCode == 3){

          digitalWrite(motor1pin1, LOW);
          digitalWrite(motor1pin2, HIGH);
          
           digitalWrite(motor2pin1, HIGH);
          digitalWrite(motor2pin2, LOW);
        
      }
    
      if(IncomingCode == 4){

          digitalWrite(motor1pin1, HIGH);
          digitalWrite(motor1pin2, LOW);
        
          digitalWrite(motor2pin1, LOW);
          digitalWrite(motor2pin2, HIGH);
      }
    
     if(IncomingCode == 5){

          digitalWrite(motor1pin1, LOW);
          digitalWrite(motor1pin2, LOW);
        
          digitalWrite(motor2pin1, LOW);
          digitalWrite(motor2pin2, LOW);
      }

    
  }
  
  delay(50);






}
